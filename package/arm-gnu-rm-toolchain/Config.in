## package/arm-gnu-rm-toolchain/Config.in
```kconfig
config BR2_PACKAGE_HOST_ARM_GNU_RM_TOOLCHAIN
	bool "host arm-gnu-rm-toolchain"
	depends on BR2_HOSTARCH = "x86_64" || BR2_HOSTARCH = "x86"
	select BR2_HOSTARCH_NEEDS_IA32_LIBS
	help
	  The GNU Embedded Toolchain for Arm is an open-source pre-built
	  suite of tools for C, C++ and Assembly programming targeting
	  Arm Cortex-M and Cortex-R family of processors.
	  It includes the GNU Compiler (GCC) and is available free of charge
	  directly from Arm for embedded software development.


	  https://developer.arm.com/open-source/gnu-toolchain/gnu-rm/downloads
```

## package/mmtest/Config.in
```kconfig
config BR2_PACKAGE_MMTEST
	bool "kernel_modules"
	depends on BR2_LINUX_KERNEL
	help
		simple kernel module
```
